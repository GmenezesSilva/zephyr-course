## app/boards/custom_scratch_esp32s3/Kconfig.custom_scratch_esp32s3
```kconfig
config BOARD_CUSTOM_SCRATCH_ESP32S3
	select SOC_ESP32S3_WROOM_N8R8
	select SOC_ESP32S3_PROCPU if BOARD_CUSTOM_SCRATCH_ESP32S3_ESP32S3_PROCPU || BOARD_CUSTOM_SCRATCH_ESP32S3_ESP32S3_PROCPU_SENSE
	select SOC_ESP32S3_APPCPU if BOARD_CUSTOM_SCRATCH_ESP32S3_ESP32S3_APPCPU
```

## app/boards/custom_scratch_esp32s3/board.yml
```yaml
board:
  name: custom_scratch_esp32s3
  full_name: Custom Scratch ESP32-S3
  vendor: Seeed Studio
  socs:
    - name: esp32s3
```

## app/drivers/my_driver/Kconfig
```kconfig
config MY_DRIVER
    bool "My Driver"
    default y
    help
      Enable support for My Driver. This driver provides control to led
```

## build_cmake/Kconfig/boards/Kconfig.defconfig
```kconfig
# Load Zephyr board defconfig descriptions.
osource "C:/Users/mene_/zephyr/boards/seeed/xiao_esp32c5/Kconfig.defconfig"
```

## build_cmake/Kconfig/boards/Kconfig.xiao_esp32c5
```kconfig
# Load board Kconfig descriptions.
osource "C:/Users/mene_/zephyr/boards/seeed/xiao_esp32c5/Kconfig.xiao_esp32c5"
```

## build_cmake/Kconfig/soc/Kconfig
```kconfig
# Load Zephyr SoC Kconfig descriptions.
osource "C:/Users/mene_/zephyr/soc/xlnx/zynqmp/Kconfig"
osource "C:/Users/mene_/zephyr/soc/xlnx/zynq7000/Kconfig"
osource "C:/Users/mene_/zephyr/soc/xlnx/versalnet/Kconfig"
osource "C:/Users/mene_/zephyr/soc/xlnx/versal2/Kconfig"
osource "C:/Users/mene_/zephyr/soc/xlnx/versal/Kconfig"
osource "C:/Users/mene_/zephyr/soc/xen/Kconfig"
osource "C:/Users/mene_/zephyr/soc/wch/ch32v/Kconfig"
osource "C:/Users/mene_/zephyr/soc/ti/simplelink/Kconfig"
osource "C:/Users/mene_/zephyr/soc/ti/mspm/Kconfig"
osource "C:/Users/mene_/zephyr/soc/ti/lm3s6965/Kconfig"
osource "C:/Users/mene_/zephyr/soc/ti/k3/Kconfig"
osource "C:/Users/mene_/zephyr/soc/ti/am13/Kconfig"
osource "C:/Users/mene_/zephyr/soc/telink/tlsr/Kconfig"
osource "C:/Users/mene_/zephyr/soc/syna/sr100/Kconfig"
osource "C:/Users/mene_/zephyr/soc/starfive/jh71xx/Kconfig"
osource "C:/Users/mene_/zephyr/soc/st/stm32/Kconfig"
osource "C:/Users/mene_/zephyr/soc/snps/qemu_arc/Kconfig"
osource "C:/Users/mene_/zephyr/soc/snps/nsim/arc_v/Kconfig"
osource "C:/Users/mene_/zephyr/soc/snps/nsim/arc_classic/Kconfig"
osource "C:/Users/mene_/zephyr/soc/snps/hsdk4xd/Kconfig"
osource "C:/Users/mene_/zephyr/soc/snps/hsdk/Kconfig"
osource "C:/Users/mene_/zephyr/soc/snps/emsk/Kconfig"
osource "C:/Users/mene_/zephyr/soc/snps/emsdp/Kconfig"
osource "C:/Users/mene_/zephyr/soc/snps/arc_iot/Kconfig"
osource "C:/Users/mene_/zephyr/soc/silabs/Kconfig"
osource "C:/Users/mene_/zephyr/soc/sifli/sf32/Kconfig"
osource "C:/Users/mene_/zephyr/soc/sifive/sifive_freedom/Kconfig"
osource "C:/Users/mene_/zephyr/soc/shakti/Kconfig"
osource "C:/Users/mene_/zephyr/soc/sensry/Kconfig"
osource "C:/Users/mene_/zephyr/soc/rockchip/Kconfig"
osource "C:/Users/mene_/zephyr/soc/renode/riscv_virtual/Kconfig"
osource "C:/Users/mene_/zephyr/soc/renode/cortex_r8_virtual/Kconfig"
osource "C:/Users/mene_/zephyr/soc/renesas/smartbond/Kconfig"
osource "C:/Users/mene_/zephyr/soc/renesas/rz/Kconfig"
osource "C:/Users/mene_/zephyr/soc/renesas/rx/Kconfig"
osource "C:/Users/mene_/zephyr/soc/renesas/rcar/Kconfig"
osource "C:/Users/mene_/zephyr/soc/renesas/ra/Kconfig"
osource "C:/Users/mene_/zephyr/soc/realtek/fingerprint/Kconfig"
osource "C:/Users/mene_/zephyr/soc/realtek/ec/Kconfig"
osource "C:/Users/mene_/zephyr/soc/realtek/bee/Kconfig"
osource "C:/Users/mene_/zephyr/soc/realtek/ameba/Kconfig"
osource "C:/Users/mene_/zephyr/soc/raspberrypi/rpi_pico/Kconfig"
osource "C:/Users/mene_/zephyr/soc/quicklogic/eos_s3/Kconfig"
osource "C:/Users/mene_/zephyr/soc/qemu/virt_riscv/Kconfig"
osource "C:/Users/mene_/zephyr/soc/qemu/or1k/Kconfig"
osource "C:/Users/mene_/zephyr/soc/qemu/malta/Kconfig"
osource "C:/Users/mene_/zephyr/soc/openisa/rv32m1/Kconfig"
osource "C:/Users/mene_/zephyr/soc/openhwgroup/cva6/Kconfig"
osource "C:/Users/mene_/zephyr/soc/oct/osd32mp15x/Kconfig"
osource "C:/Users/mene_/zephyr/soc/nxp/s32/Kconfig"
osource "C:/Users/mene_/zephyr/soc/nxp/rw/Kconfig"
osource "C:/Users/mene_/zephyr/soc/nxp/mcx/Kconfig"
osource "C:/Users/mene_/zephyr/soc/nxp/lpc/Kconfig"
osource "C:/Users/mene_/zephyr/soc/nxp/layerscape/Kconfig"
osource "C:/Users/mene_/zephyr/soc/nxp/kinetis/Kconfig"
osource "C:/Users/mene_/zephyr/soc/nxp/imxrt/Kconfig"
osource "C:/Users/mene_/zephyr/soc/nxp/imx/Kconfig"
osource "C:/Users/mene_/zephyr/soc/nuvoton/numicro/Kconfig"
osource "C:/Users/mene_/zephyr/soc/nuvoton/numaker/Kconfig"
osource "C:/Users/mene_/zephyr/soc/nuvoton/npcx/Kconfig"
osource "C:/Users/mene_/zephyr/soc/nuvoton/npcm/Kconfig"
osource "C:/Users/mene_/zephyr/soc/nordic/Kconfig"
osource "C:/Users/mene_/zephyr/soc/neorv32/Kconfig"
osource "C:/Users/mene_/zephyr/soc/native/inf_clock/Kconfig"
osource "C:/Users/mene_/zephyr/soc/microchip/smartfusion2/Kconfig"
osource "C:/Users/mene_/zephyr/soc/microchip/sam/sama7/Kconfig"
osource "C:/Users/mene_/zephyr/soc/microchip/sam/sama5/Kconfig"
osource "C:/Users/mene_/zephyr/soc/microchip/sam/sam_d5x_e5x/Kconfig"
osource "C:/Users/mene_/zephyr/soc/microchip/pic64/Kconfig"
osource "C:/Users/mene_/zephyr/soc/microchip/pic32c/pic32cz_ca/Kconfig"
osource "C:/Users/mene_/zephyr/soc/microchip/pic32c/pic32cx_sg/Kconfig"
osource "C:/Users/mene_/zephyr/soc/microchip/pic32c/pic32cm_sg_gc/Kconfig"
osource "C:/Users/mene_/zephyr/soc/microchip/pic32c/pic32cm_pl/Kconfig"
osource "C:/Users/mene_/zephyr/soc/microchip/pic32c/pic32cm_jh/Kconfig"
osource "C:/Users/mene_/zephyr/soc/microchip/pic32c/pic32ck_sg_gc/Kconfig"
osource "C:/Users/mene_/zephyr/soc/microchip/miv/Kconfig"
osource "C:/Users/mene_/zephyr/soc/microchip/mec/Kconfig"
osource "C:/Users/mene_/zephyr/soc/mediatek/mt8xxx/Kconfig"
osource "C:/Users/mene_/zephyr/soc/lowrisc/opentitan/Kconfig"
osource "C:/Users/mene_/zephyr/soc/litex/Kconfig"
osource "C:/Users/mene_/zephyr/soc/ite/ec/Kconfig"
osource "C:/Users/mene_/zephyr/soc/intel/wildcat_lake/Kconfig"
osource "C:/Users/mene_/zephyr/soc/intel/raptor_lake/Kconfig"
osource "C:/Users/mene_/zephyr/soc/intel/panther_lake/Kconfig"
osource "C:/Users/mene_/zephyr/soc/intel/nova_lake/Kconfig"
osource "C:/Users/mene_/zephyr/soc/intel/lakemont/Kconfig"
osource "C:/Users/mene_/zephyr/soc/intel/intel_socfpga_std/Kconfig"
osource "C:/Users/mene_/zephyr/soc/intel/intel_socfpga/Kconfig"
osource "C:/Users/mene_/zephyr/soc/intel/intel_niosv/Kconfig"
osource "C:/Users/mene_/zephyr/soc/intel/intel_ish/Kconfig"
osource "C:/Users/mene_/zephyr/soc/intel/intel_adsp/Kconfig"
osource "C:/Users/mene_/zephyr/soc/intel/elkhart_lake/Kconfig"
osource "C:/Users/mene_/zephyr/soc/intel/atom/Kconfig"
osource "C:/Users/mene_/zephyr/soc/intel/apollo_lake/Kconfig"
osource "C:/Users/mene_/zephyr/soc/intel/alder_lake/Kconfig"
osource "C:/Users/mene_/zephyr/soc/infineon/psoc4/Kconfig"
osource "C:/Users/mene_/zephyr/soc/infineon/edge/Kconfig"
osource "C:/Users/mene_/zephyr/soc/infineon/cat3/Kconfig"
osource "C:/Users/mene_/zephyr/soc/infineon/cat1c/Kconfig"
osource "C:/Users/mene_/zephyr/soc/infineon/cat1b/Kconfig"
osource "C:/Users/mene_/zephyr/soc/infineon/cat1a/Kconfig"
osource "C:/Users/mene_/zephyr/soc/gd/gd32/Kconfig"
osource "C:/Users/mene_/zephyr/soc/gaisler/leon3/Kconfig"
osource "C:/Users/mene_/zephyr/soc/gaisler/gr716a/Kconfig"
osource "C:/Users/mene_/zephyr/soc/focaltech/Kconfig"
osource "C:/Users/mene_/zephyr/soc/espressif/Kconfig"
osource "C:/Users/mene_/zephyr/soc/ene/kb1200/Kconfig"
osource "C:/Users/mene_/zephyr/soc/ene/kb106x/Kconfig"
osource "C:/Users/mene_/zephyr/soc/elan/em32f967/Kconfig"
osource "C:/Users/mene_/zephyr/soc/egis/Kconfig"
osource "C:/Users/mene_/zephyr/soc/efinix/sapphire/Kconfig"
osource "C:/Users/mene_/zephyr/soc/cdns/xtensa_sample_controller/Kconfig"
osource "C:/Users/mene_/zephyr/soc/cdns/swerv/Kconfig"
osource "C:/Users/mene_/zephyr/soc/cdns/sample_controller32/Kconfig"
osource "C:/Users/mene_/zephyr/soc/cdns/dc233c/Kconfig"
osource "C:/Users/mene_/zephyr/soc/brcm/bcmvk/Kconfig"
osource "C:/Users/mene_/zephyr/soc/brcm/bcm2712/Kconfig"
osource "C:/Users/mene_/zephyr/soc/brcm/bcm2711/Kconfig"
osource "C:/Users/mene_/zephyr/soc/brcm/bcm2710/Kconfig"
osource "C:/Users/mene_/zephyr/soc/blackberry/qnxhv_vm/Kconfig"
osource "C:/Users/mene_/zephyr/soc/bflb/Kconfig"
osource "C:/Users/mene_/zephyr/soc/atmel/sam0/Kconfig"
osource "C:/Users/mene_/zephyr/soc/atmel/sam/Kconfig"
osource "C:/Users/mene_/zephyr/soc/aspeed/Kconfig"
osource "C:/Users/mene_/zephyr/soc/arm/Kconfig"
osource "C:/Users/mene_/zephyr/soc/antmicro/myra/Kconfig"
osource "C:/Users/mene_/zephyr/soc/andestech/Kconfig"
osource "C:/Users/mene_/zephyr/soc/amd/acp_7_x/Kconfig"
osource "C:/Users/mene_/zephyr/soc/amd/acp_7_0/Kconfig"
osource "C:/Users/mene_/zephyr/soc/amd/acp_6_0/Kconfig"
osource "C:/Users/mene_/zephyr/soc/ambiq/Kconfig"
osource "C:/Users/mene_/zephyr/soc/allwinner/sun8i_h3/Kconfig"
osource "C:/Users/mene_/zephyr/soc/allwinner/sun50i_h618/Kconfig"
osource "C:/Users/mene_/zephyr/soc/alif/ensemble/Kconfig"
osource "C:/Users/mene_/zephyr/soc/alif/balletto/Kconfig"
osource "C:/Users/mene_/zephyr/soc/aesc/Kconfig"
osource "C:/Users/mene_/zephyr/soc/adi/max32/Kconfig"
```
